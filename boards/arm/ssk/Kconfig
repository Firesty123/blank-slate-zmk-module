## boards/arm/ssk/Kconfig
```kconfig
# SPDX-License-Identifier: MIT

config BOARD_ENABLE_DCDC
    bool "Enable DCDC mode"
    select SOC_DCDC_NRF52X
    default y
    depends on (BOARD_SSK_LEFT || BOARD_SSK_RIGHT)
```

## boards/shields/ssk/Kconfig.defconfig
```kconfig
if SHIELD_SSK_LEFT

config ZMK_KEYBOARD_NAME
    default "SSK"

config ZMK_SPLIT_ROLE_CENTRAL
    default y

endif

if SHIELD_SSK_LEFT || SHIELD_SSK_RIGHT

config ZMK_SPLIT
    default y

endif
```

## boards/shields/ssk/Kconfig.shield
```kconfig
# Copyright (c) 2020 Pete Johanson
# SPDX-License-Identifier: MIT

config SHIELD_SSK_LEFT
    def_bool $(shields_list_contains,ssk_left)

config SHIELD_SSK_RIGHT
    def_bool $(shields_list_contains,ssk_right)
```
